## conf/layer.conf
```bitbake
# We have a conf and classes directory, add to BBPATH
BBPATH .= ":${LAYERDIR}"

# We have recipes-* directories, add to BBFILES
BBFILES += "${LAYERDIR}/recipes-*/*/*.bb \
            ${LAYERDIR}/recipes-*/*/*.bbappend"

BBFILE_COLLECTIONS += "meta-wpi"
BBFILE_PATTERN_meta-wpi = "^${LAYERDIR}/"
BBFILE_PRIORITY_meta-wpi = "9"

LAYERDEPENDS_meta-wpi = "core"
LAYERSERIES_COMPAT_meta-wpi = "scarthgap"
```

## conf/machine/opgyro.conf
```bitbake
MACHINEOVERRIDES =. "opgyro:"
require conf/machine/imx93-11x11-lpddr4x-evk.conf

MACHINE="opgyro"

KERNEL_DEVICETREE = " \
	wpi/op-gyro.dtb \
	wpi/op-gyro-lpspi-slave.dtb \
	wpi/op-gyro-lpspi.dtb \
	wpi/op-gyro-lpuart7.dtb \
	wpi/op-gyro-dsi-ili9881c.dtb \
"

#UBOOT_MACHINE = "op_gyro_defconfig"

# For using op_gyro_defconfig
UBOOT_CONFIG_BASENAME = "op_gyro"

MACHINE_FEATURES:remove = " iw612"
MACHINE_FEATURES:append = " nxp8997"

IMAGE_INSTALL:append = " libqmi"

#MACHINE_FEATURES:remove = " iw612"
#MACHINE_FEATURES:append = " nxp8997"
MACHINE_FEATURES:append:opgyro = " dpdk"
MACHINE_FIRMWARE:append:opgyro = " ethos-u-firmware"
IMAGE_INSTALL:append = " udev-rules-wpi udev-wpi-extraconf guiopgyro"

# Remove meta-freescale default i.MX93 device tree
KERNEL_DEVICETREE:remove = " \
	freescale/imx93-11x11-evk-aud-hat.dtb \
	freescale/imx93-11x11-evk-boe-wxga-lvds-panel.dtb \
	freescale/imx93-11x11-evk-flexio-i2c.dtb \
	freescale/imx93-11x11-evk-flexspi-m2.dtb \
	freescale/imx93-11x11-evk-i3c.dtb \
	freescale/imx93-11x11-evk-inmate.dtb \
	freescale/imx93-11x11-evk-lpspi-slave.dtb \
	freescale/imx93-11x11-evk-lpspi.dtb \
	freescale/imx93-11x11-evk-lpuart.dtb \
	freescale/imx93-11x11-evk-mqs.dtb \
	freescale/imx93-11x11-evk-mt9m114.dtb \
	freescale/imx93-11x11-evk-rm67199.dtb \
	freescale/imx93-11x11-evk-root.dtb \
"
```
